/*
 * ======================================================================================
 * PROJECT: M5Console - SLAVE 2 (Relays 1-4)
 * HARDWARE: M5Atom Lite + Unit 4Relay (Grove Port 26, 32)
 * MAC ADDRESS: 90:15:06:FA:2C:20
 * AUTHOR: Generated by AI Assistant guided by Mauricio Martins.
 * ======================================================================================
 */

#include <WiFi.h>
#include <esp_now.h>
#include <esp_wifi.h>
#include <FastLED.h>
#include "Unit_4RELAY.h"

// --- CONFIGURATION ---
#define LED_PIN     27
#define NUM_LEDS    1
#define LED_TYPE    WS2812
#define COLOR_ORDER GRB
#define BRIGHTNESS  204 // 80%

CRGB leds[NUM_LEDS];
UNIT_4RELAY relay;

// --- DATA STRUCTURE ---
typedef struct struct_message {
  uint8_t relayId; // 0-3 (Maps to Relay 1-4 on this unit)
  bool state;
} struct_message;

struct_message myData;

// --- CALLBACK ---
void OnDataRecv(const esp_now_recv_info_t * info, const uint8_t *incomingData, int len) {
  if (len != sizeof(myData)) return;
  memcpy(&myData, incomingData, sizeof(myData));
  
  // Visual Feedback: Green = Data Received
  fill_solid(leds, NUM_LEDS, CRGB::Green);
  FastLED.show();

  // Actuate Relay
  relay.relayWrite(myData.relayId, myData.state);
  relay.ledWrite(myData.relayId, myData.state);
  
  // Debug
  Serial.printf("SLAVE 2 RX -> Relay: %d | State: %s\n", myData.relayId + 1, myData.state ? "ON" : "OFF");
}

void setup() {
  Serial.begin(115200);

  // 1. Setup LED (FastLED)
  FastLED.addLeds<LED_TYPE, LED_PIN, COLOR_ORDER>(leds, NUM_LEDS);
  FastLED.setBrightness(BRIGHTNESS);
  fill_solid(leds, NUM_LEDS, CRGB::Red); // Start Red (Standby)
  FastLED.show();

  // 2. Setup Relays
  Wire.begin(26, 32);
  relay.begin();
  relay.Init(0); 

  // 3. Setup WiFi (Station Mode, Channel 1)
  WiFi.mode(WIFI_STA);
  WiFi.disconnect();
  esp_wifi_set_promiscuous(true);
  esp_wifi_set_channel(1, WIFI_SECOND_CHAN_NONE);
  esp_wifi_set_promiscuous(false);

  // 4. Setup ESP-NOW
  if (esp_now_init() != ESP_OK) {
    Serial.println("Error initializing ESP-NOW");
    while(1) { 
      fill_solid(leds, NUM_LEDS, CRGB::White); FastLED.show(); delay(100);
      fill_solid(leds, NUM_LEDS, CRGB::Red); FastLED.show(); delay(100);
    }
  }

  esp_now_register_recv_cb(OnDataRecv);
  Serial.println("Slave 2 Ready (Channel 1)");
}

void loop() {
  delay(10);
}
